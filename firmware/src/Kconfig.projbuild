## firmware/src/Kconfig.projbuild
```kconfig
menu "Plant Watering System Configuration"

    config PWS_WIFI_SSID
        string "Wi-Fi SSID"
        default ""

    config PWS_WIFI_PASSWORD
        string "Wi-Fi password"
        default ""

    config PWS_MQTT_BROKER_URI
        string "MQTT broker URI"
        default "mqtt://10.13.37.42:1883"

    config PWS_MQTT_USERNAME
        string "MQTT username"
        default ""
    
    config PWS_MQTT_PASSWORD
        string "MQTT password"

    config PWS_MOISTURE_DRY_RAW
        int "Moisture sensor raw reading at 0% (dry)"
        range -1 4095
        default -1

    config PWS_MOISTURE_WET_RAW
        int "Moisture sensor raw reading at 100% (wet)"
        range -1 4095
        default -1

endmenu
```
